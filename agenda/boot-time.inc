\usepackage{ifthen}
\def \training{boot-time}

% Title
\ifthenelse{\equal{\agendalanguage}{french}}{
  \def \trainingtitle{Formation optimisation du temps de démarrage de Linux embarqué}
}{
  \def \trainingtitle{Embedded Linux boot time optimization training}
}

% Duration
\ifthenelse{\equal{\trainingtype}{online}}{
  \def \trainingduration{4}
}{
  \def \trainingduration{3}
}

% Training objectives
\ifthenelse{\equal{\agendalanguage}{french}}{
  \def \traininggoals{
    \begin{itemize}
    \item Être capable d'utiliser les outils et techniques pour mesurer
      le temps de démarrage d'un système embarqué.
    \item Être capable de réduire le temps de démarrage au niveau de
      l'initialisation de l'espace utilisateur Linux.
    \item Être capable de réduire le temps de démarrage au niveau de
      l'initialisation du noyau Linux.
    \item Être capable de réduire le temps de démarrage au niveau de
      l'initialisation du chargeur de démarrage.
    \item Être capable de mettre en oeuvre d'autres techniques avancées
      et alternatives d'optimisation du temps de démarrage.
    \end{itemize}
  }
}{
  \def \traininggoals{
    \begin{itemize}
    \item Be able to use various tools and techniques to measure the
      boot time of an embedded Linux system.
    \item Be able to reduce the boot time spent during the {\em
        user-space} initialization.
    \item Be able to reduce the boot time spent during the {\em
        kernel} initialization.
    \item Be able to reduce the boot time spent during the {\em
        bootloader} initialization.
    \item Be able to use advanced and alternatives techniques of boot
      time optimization.
    \end{itemize}
  }
}

% Training prerequisites
\def \trainingprerequisites{
  \begin{itemize}
    \prerequisitecommandline
    \prerequisiteembeddedlinux
    \prerequisiteenglish
  \end{itemize}
}

% Training audience
\ifthenelse{\equal{\agendalanguage}{french}}{
  \def \trainingaudience{
    Sociétés et ingénieurs développeurs de systèmes Linux embarqués.
    \newline Personnes offrant de l'assistance à de tels développeurs.
  }
}{
  \def \trainingaudience{
    People developing embedded Linux systems.
    \newline People supporting embedded Linux system developers.
  }
}

% Time ratio
\def \onsitelecturetimeratio{40}
\def \onsitelabtimeratio{60}
