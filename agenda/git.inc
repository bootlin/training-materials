\usepackage{ifthen}
\def \training{git}

% Title
\def \trainingtitle{Git training}

% Duration
\def \trainingduration{1}

% Training objectives
\def \traininggoals{
  \begin{itemize}
  \item Be able to understand the basic principles of version control
    and Git
  \item Be able to understand the terminology used by Git
  \item Be able to perform basic version control operations with Git
  \item Be able to create, use and manage branches with Git
  \item Be able to use {\em remote} repositories with Git
  \item Be able to use the main collaboration techniques with Git
  \item Be able to use different typical workflows used for version
    control with Git
  \end{itemize}
}

% Training prerequisites
\def \trainingprerequisites{
  \begin{itemize}
    \prerequisitecommandline
    \prerequisiteenglish
  \end{itemize}
}

% Training audience
\def \trainingaudience{
  Companies already using or interested in using
  Git to manage their source code.
}

% Time ratio
\def \onsitelecturetimeratio{40}
\def \onsitelabtimeratio{60}
