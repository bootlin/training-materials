## lab-data/security-imx93-frdm/FIT-verification/unsigned_fit.its
```
/dts-v1/;

/ {
        description = "Kernel fitImage for security training Linux/7.0/freiheit93";
        #address-cells = <1>;

        images {
                kernel-1 {
                        description = "Linux kernel";
                        data =
				/incbin/("build/tmp-glibc/work/freiheit93-oe-linux/linux-kiss/7.0/build/linux.bin");
                        type = "kernel";
                        arch = "arm64";
                        os = "linux";
                        compression = "none";
                        load = <0x80400000>;
                        entry = <0x83000000>;
                        hash-1 {
                                algo = "sha256";
                        };
                };
                fdt-imx93-11x11-frdm.dtb {
                        description = "Flattened Device Tree blob";
                        data = /incbin/("build/tmp-glibc/deploy/images/freiheit93/imx93-11x11-frdm.dtb");
                        type = "flat_dt";
                        arch = "arm64";
                        compression = "none";
                        hash-1 {
                                algo = "sha256";
                        };
                };
	};

        configurations {
                default = "conf-imx93-11x11-frdm.dtb";
                conf-imx93-11x11-frdm.dtb {
                        description = "1 Linux kernel, FDT blob";
                        kernel = "kernel-1";
                        fdt = "fdt-imx93-11x11-frdm.dtb";
                        hash-1 {
                                algo = "sha256";
                        };
                };
	};
};
```
