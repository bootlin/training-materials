## lab-data/preempt-rt/stm32mp157a_dk1_rt_defconfig
```kconfig
BR2_arm=y
BR2_cortex_a7=y
BR2_TOOLCHAIN_BUILDROOT_CXX=y
BR2_ROOTFS_OVERLAY="board/stmicroelectronics/stm32mp157a-dk1/overlay/"
BR2_ROOTFS_POST_IMAGE_SCRIPT="board/stmicroelectronics/common/stm32mp157/post-image.sh"
BR2_LINUX_KERNEL=y
BR2_LINUX_KERNEL_CUSTOM_GIT=y
BR2_LINUX_KERNEL_CUSTOM_REPO_URL="git://git.kernel.org/pub/scm/linux/kernel/git/rt/linux-stable-rt.git"
BR2_LINUX_KERNEL_CUSTOM_REPO_VERSION="v6.6.15-rt22"
BR2_LINUX_KERNEL_USE_CUSTOM_CONFIG=y
BR2_LINUX_KERNEL_CUSTOM_CONFIG_FILE="board/stmicroelectronics/stm32mp157a-dk1/linux.config"
BR2_LINUX_KERNEL_DTS_SUPPORT=y
BR2_LINUX_KERNEL_INTREE_DTS_NAME="st/stm32mp157a-dk1"
BR2_LINUX_KERNEL_INSTALL_TARGET=y
BR2_PACKAGE_LINUX_TOOLS_RTLA=y
BR2_PACKAGE_RT_TESTS=y
BR2_PACKAGE_STRESS_NG=y
BR2_PACKAGE_TRACE_CMD=y
BR2_PACKAGE_LIBGPIOD=y
BR2_PACKAGE_LIBGPIOD_TOOLS=y
BR2_PACKAGE_IPERF3=y
BR2_PACKAGE_IPROUTE2=y
BR2_PACKAGE_UTIL_LINUX=y
BR2_PACKAGE_UTIL_LINUX_SCHEDUTILS=y
BR2_TARGET_ROOTFS_EXT2=y
BR2_TARGET_ROOTFS_EXT2_4=y
BR2_TARGET_ROOTFS_EXT2_SIZE="120M"
# BR2_TARGET_ROOTFS_TAR is not set
BR2_TARGET_ARM_TRUSTED_FIRMWARE=y
BR2_TARGET_ARM_TRUSTED_FIRMWARE_CUSTOM_VERSION=y
BR2_TARGET_ARM_TRUSTED_FIRMWARE_CUSTOM_VERSION_VALUE="v2.5"
BR2_TARGET_ARM_TRUSTED_FIRMWARE_PLATFORM="stm32mp1"
BR2_TARGET_ARM_TRUSTED_FIRMWARE_ADDITIONAL_VARIABLES="STM32MP_SDMMC=1 AARCH32_SP=sp_min DTB_FILE_NAME=stm32mp157a-dk1.dtb E=0"
BR2_TARGET_ARM_TRUSTED_FIRMWARE_IMAGES="*.stm32"
BR2_TARGET_ARM_TRUSTED_FIRMWARE_NEEDS_DTC=y
BR2_TARGET_UBOOT=y
BR2_TARGET_UBOOT_BUILD_SYSTEM_KCONFIG=y
BR2_TARGET_UBOOT_CUSTOM_VERSION=y
BR2_TARGET_UBOOT_CUSTOM_VERSION_VALUE="2023.04"
BR2_TARGET_UBOOT_BOARD_DEFCONFIG="stm32mp15_trusted"
BR2_TARGET_UBOOT_NEEDS_PYLIBFDT=y
BR2_TARGET_UBOOT_NEEDS_OPENSSL=y
# BR2_TARGET_UBOOT_FORMAT_BIN is not set
BR2_TARGET_UBOOT_FORMAT_STM32=y
BR2_TARGET_UBOOT_CUSTOM_MAKEOPTS="DEVICE_TREE=stm32mp157a-dk1"
BR2_PACKAGE_HOST_ENVIRONMENT_SETUP=y
BR2_PACKAGE_HOST_GENIMAGE=y
```

## lab-data/security-imx93-frdm/board_setup/meta-security-training/conf/distro/security-training.conf
```bitbake
include conf/distro/kiss.conf

DISTRO_NAME = "security training Linux"
DISTRO_VERSION = "1.0"

SDK_VENDOR = "-securitytraining"
SDK_VERSION = "${DISTRO_VERSION}"

DISTRO_FEATURES = "ipv4 ipv6 wifi zeroconf usbgadget usbhost systemd pni-names seccomp acl xattr pam selinux rauc"
INIT_MANAGER = "systemd"

PREFERRED_PROVIDER_virtual/refpolicy ?= "refpolicy-standard"
FIRST_BOOT_RELABEL = "1"

# This should ideally live in machine/freiheit93.conf
KERNEL_IMAGETYPE = "fitImage"
FIT_KERNEL_COMP_ALG = "none"
FIT_KERNEL_COMP_EXTENSION = ""
IMAGE_BOOT_FILES = " ${KERNEL_IMAGETYPE}"
UBOOT_ARCH = "arm64"
# We need these to avoid the FIT image embedding a load address
# that will trigger an exception.
UBOOT_LOADADDRESS = "0x80400000"
UBOOT_ENTRYPOINT = "0x83000000"
```

## lab-data/security-imx93-frdm/board_setup/meta-security-training/conf/layer.conf
```bitbake
# We have a conf and classes directory, add to BBPATH
BBPATH .= ":${LAYERDIR}"

# We have recipes-* directories, add to BBFILES
BBFILES += "${LAYERDIR}/recipes-*/*/*.bb \
            ${LAYERDIR}/recipes-*/*/*.bbappend"

BBFILE_COLLECTIONS += "meta-security-training"
BBFILE_PATTERN_meta-security-training = "^${LAYERDIR}/"
BBFILE_PRIORITY_meta-security-training = "10"

LAYERDEPENDS_meta-security-training = "core meta-kiss"
LAYERSERIES_COMPAT_meta-security-training = "scarthgap"
```
