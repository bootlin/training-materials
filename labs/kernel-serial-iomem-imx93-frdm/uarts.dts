&lpuart3 { 
	compatible = "bootlin,serial";
	pinctrl-names = "default";
	pinctrl-0 = <&pinctrl_uart3>;
	status = "okay";
};

&lpuart8 { 
	compatible = "bootlin,serial";
	pinctrl-names = "default";
	pinctrl-0 = <&pinctrl_uart8>;
	status = "okay";
};
