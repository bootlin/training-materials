pinctrl_uart3: uart3grp {
	fsl,pins = <
		MX93_PAD_GPIO_IO15__LPUART3_RX 0x31e
		MX93_PAD_GPIO_IO14__LPUART3_TX 0x31e
	>;
};

pinctrl_uart8: uart8grp {
	fsl,pins = <
		MX93_PAD_GPIO_IO13__LPUART8_RX 0x31e
		MX93_PAD_GPIO_IO12__LPUART8_TX 0x31e
	>;
};
