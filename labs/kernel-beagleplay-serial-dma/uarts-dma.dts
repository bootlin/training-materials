&main_uart5 {
        compatible = "bootlin,serial";
        dmas = <&main_pktdma 0xc405 0>;
        dma-names = "tx";
};

&main_uart6 {
        compatible = "bootlin,serial";
        pinctrl-names = "default";
        pinctrl-0 = <&main_uart6_pins>;
        dmas = <&main_pktdma 0xc406 0>;
        dma-names = "tx";
};
