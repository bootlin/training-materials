&main_pmx0 {
	/* Pins COPI (TX) and CIPO (RX) of the mikrobus connector */
	main_uart6_pins: main_uart6_pins {
		pinctrl-single,pins = <
			AM62X_IOPAD(0x0198, PIN_INPUT_PULLUP, 3) /* (A19) MCASP0_AXR2.UART6_TXD */
			AM62X_IOPAD(0x0194, PIN_INPUT_PULLUP, 3) /* (B19) MCASP0_AXR3.UART6_RXD */
		>;
	};
};

&main_spi2 {
	status = "disabled";
};
