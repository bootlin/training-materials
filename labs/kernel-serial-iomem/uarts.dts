&uart2 {
	compatible = "bootlin,serial";
        status = "okay";
        pinctrl-names = "default";
        pinctrl-0 = <&uart2_pins>;
};

&uart4 {
	compatible = "bootlin,serial";
        status = "okay";
        pinctrl-names = "default";
        pinctrl-0 = <&uart4_pins>;
};
